## config/west.yml
```yaml
manifest:
  defaults:
    revision: v0.3 # Pin everything to v0.3

  remotes:
    - name: zmkfirmware
      url-base: https://github.com/zmkfirmware
    - name: urob
      url-base: https://github.com/urob
  projects:
    - name: zmk
      remote: zmkfirmware
      import: app/west.yml
    - name: zmk-helpers
      remote: urob
    - name: zmk-unicode
      remote: urob
    - name: zmk-auto-layer
      remote: urob
    - name: zmk-tri-state
      remote: urob
    - name: zmk-adaptive-key
      remote: urob

  self:
    path: config
```
