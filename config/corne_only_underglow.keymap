#define KEYS_L LT0 LT1 LT2 LT3 LT4 LT5 LM0 LM1 LM2 LM3 LM4 LM5 LB0 LB1 LB2 LB3 LB4 LB5 // Left-hand keys.
#define KEYS_R RT0 RT1 RT2 RT3 RT4 RT5 RM0 RM1 RM2 RM3 RM4 RM5 RB0 RB1 RB2 RB3 RB4 RB5  // Right-hand keys.
#define THUMBS LH2 LH1 LH0 RH0 RH1 RH2                                     // Thumb keys.

#include "zmk-helpers/key-labels/42.h"

#define ZMK_BASE_LAYER(name, LT, RT, LM, RM, LB, RB, LH, RH)                                      \
    ZMK_LAYER(                                                                                    \
        name,                                                                                     \
        &lt 5 ESC            LT                                            RT           &kp BACKSPACE  \
        &kp TAB              LM                                            RM           &kp SQT    \
       &kp LEFT_SHIFT        LB                                            RB           &kp RSHFT   \
              &kp LGUI  &mo LOWER LH                   RH   &mo RAISE &mo RAISE  \
                                                     )
#include "common.keymap"

/ {
&led_strip {
    chain-length = <12>;
};
}
