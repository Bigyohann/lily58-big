#include <behaviors.dtsi>
#include <behaviors/unicode.dtsi>
#include <dt-bindings/zmk/bt.h>
#include <dt-bindings/zmk/keys.h>
#include <dt-bindings/zmk/pointing.h>
#include "zmk-helpers/helper.h"

#ifndef ZMK_BASE_LAYER
  #define ZMK_BASE_LAYER(name, LT, RT, LM, RM, LB, RB, LH, RH)                 \
      ZMK_LAYER(name, LT RT LM RM LB RB LH RH)
#endif

&uc {
  default-mode = <UC_MODE_MACOS>;
};

// define layers name with numbers
#define MACOS 0
#define WINDOWS 1
#define LOWER 2
#define RAISE 3
#define SETTINGS 4

#include "features/macros.dtsi"
#include "features/combos.dtsi"
#include "features/hrm.dtsi"
ZMK_BASE_LAYER(MACOS,
//╭─────────────┬─────────────┬─────────────┬─────────────┬─────────────╮ ╭─────────────┬─────────────┬─────────────┬─────────────┬─────────────╮
    &kp Q         &kp W         &kp E         &kp R         &kp T       ,   &kp Y         &kp U         &kp I         &kp O         &kp P       ,
//├─────────────┼─────────────┼─────────────┼─────────────┼─────────────┤ ├─────────────┼─────────────┼─────────────┼─────────────┼─────────────┤
    &hml LCTRL A   &hml LALT S   &hml LGUI D  &hml LSHFT F  &kp G      ,    &kp H        &hmr RSHFT J &hmr LGUI K  &hmr LALT L  &hmr LCTRL SEMI ,
//├─────────────┼─────────────┼─────────────┼─────────────┼─────────────┤ ├─────────────┼─────────────┼─────────────┼─────────────┼─────────────┤
    &kp Z         &kp X         &kp C         &kp V         &kp B       ,   &kp N         &kp M         &kp COMMA     &kp DOT       &kp FSLH    ,
//╰─────────────┼─────────────┴─────────────┼─────────────┼─────────────┤ ├─────────────┼─────────────┼─────────────┴───────────────────────────╯
                                                             &kp SPACE,    &kp RET
//                                                        ╰─────────────╯ ╰─────────────╯
)

ZMK_BASE_LAYER(WINDOWS,
//╭─────────────┬─────────────┬─────────────┬─────────────┬─────────────╮ ╭─────────────┬─────────────┬─────────────┬─────────────┬─────────────╮
    &kp Q         &kp W         &kp E         &kp R         &kp T       ,   &kp Y         &kp U         &kp I         &kp O         &kp P       ,
//├─────────────┼─────────────┼─────────────┼─────────────┼─────────────┤ ├─────────────┼─────────────┼─────────────┼─────────────┼─────────────┤
    &hml LCTRL A   &hml LALT S   &hml LGUI D  &hml LSHFT F  &kp G      ,    &kp H        &hmr RSHFT J &hmr LGUI K  &hmr LALT L  &hmr LCTRL SEMI ,
//├─────────────┼─────────────┼─────────────┼─────────────┼─────────────┤ ├─────────────┼─────────────┼─────────────┼─────────────┼─────────────┤
    &kp Z         &kp X         &kp C         &kp V         &kp B       ,   &kp N         &kp M         &kp COMMA     &kp DOT       &kp FSLH    ,
//╰─────────────┼─────────────┴─────────────┼─────────────┼─────────────┤ ├─────────────┼─────────────┼─────────────┴───────────────────────────╯
                                                             &kp SPACE,    &kp RET
//                                                        ╰─────────────╯ ╰─────────────╯
)

ZMK_BASE_LAYER(LOWER,
//╭─────────────┬─────────────┬─────────────┬─────────────┬─────────────╮ ╭─────────────┬─────────────┬─────────────┬─────────────┬─────────────╮
    &kp N1        &kp N2        &kp N3        &kp N4        &kp N5      ,   &kp N6        &kp N7        &kp N8        &kp N9        &kp N0      ,
//├─────────────┼─────────────┼─────────────┼─────────────┼─────────────┤ ├─────────────┼─────────────┼─────────────┼─────────────┼─────────────┤
    &hml LCTRL GRAVE &hml LALT EXCL &hml LGUI AT &hml LSHFT HASH &kp DLLR ,    &kp CARET      &hmr RSHFT AMPS &hmr LGUI STAR &hmr LALT LPAR &hmr LCTRL RPAR ,
//├─────────────┼─────────────┼─────────────┼─────────────┼─────────────┤ ├─────────────┼─────────────┼─────────────┼─────────────┼─────────────┤
    &kp UNDER    &kp MINUS    &kp FSLH     &kp PIPE      &kp BSLH      ,   &kp PLUS     &kp EQUAL    &kp LBRC        &kp RBRC      &kp TILDE   ,
//╰─────────────┼─────────────┴─────────────┼─────────────┼─────────────┤ ├─────────────┼─────────────┼─────────────┴───────────────────────────╯
                                                               &kp SPACE,    &kp RET
//                                                               ╰─────────────╯ ╰─────────────╯
)
ZMK_BASE_LAYER(RAISE,
//╭─────────────┬─────────────┬─────────────┬─────────────┬─────────────╮ ╭─────────────┬─────────────┬─────────────┬─────────────┬─────────────╮
    &kp N1        &kp N2        &kp N3        &kp N4        &kp N5      ,   &kp N6        &kp N7        &kp N8        &kp N9        &kp N0      ,
//├─────────────┼─────────────┼─────────────┼─────────────┼─────────────┤ ├─────────────┼─────────────┼─────────────┼─────────────┼─────────────┤
    &hml LCTRL C_PREV &hml LALT C_PP &hml LGUI C_NEXT &hml LSHFT C_VOL_UP &kp C_VOL_DN ,    &kp LEFT      &hmr RSHFT DOWN_ARROW &hmr LGUI UP_ARROW &hmr LALT RIGHT_ARROW &hmr LCTRL RIGHT_ARROW,
//├─────────────┼─────────────┼─────────────┼─────────────┼─────────────┤ ├─────────────┼─────────────┼─────────────┼─────────────┼─────────────┤
    &arrow        &equalsarrow &trans        &trans        &trans        ,   &trans        &trans          &trans          &trans       &trans      ,
//╰─────────────┼─────────────┴─────────────┼─────────────┼─────────────┤ ├─────────────┼─────────────┼─────────────┴───────────────────────────╯
                                                               &kp SPACE,    &kp RET
//                                                               ╰─────────────╯ ╰─────────────╯
)
ZMK_BASE_LAYER(SETTINGS,
//╭─────────────┬─────────────┬─────────────┬─────────────┬─────────────╮ ╭─────────────┬─────────────┬─────────────┬─────────────┬─────────────╮
    &bt BT_SEL 0  &bt BT_SEL 1  &bt BT_SEL 2  &bt BT_SEL 3  &bt BT_SEL 4      ,   &kp N6        &kp N7        &kp N8        &kp N9        &kp N0      ,
//├─────────────┼─────────────┼─────────────┼─────────────┼─────────────┤ ├─────────────┼─────────────┼─────────────┼─────────────┼─────────────┤
    &hml LCTRL C_PREV &hml LALT C_PP &hml LGUI C_NEXT &hml LSHFT C_VOL_UP &kp C_VOL_DN ,    &kp LEFT      &hmr RSHFT DOWN_ARROW &hmr LGUI UP_ARROW &hmr LALT RIGHT_ARROW &hmr LCTRL RIGHT_ARROW,
//├─────────────┼─────────────┼─────────────┼─────────────┼─────────────┤ ├─────────────┼─────────────┼─────────────┼─────────────┼─────────────┤
    &arrow        &equalsarrow &trans        &trans        &trans        ,   &trans        &trans          &trans          &trans       &trans      ,
//╰─────────────┼─────────────┴─────────────┼─────────────┼─────────────┤ ├─────────────┼─────────────┼─────────────┴───────────────────────────╯
                                                               &kp SPACE,    &kp RET
//                                                               ╰─────────────╯ ╰─────────────╯
)
