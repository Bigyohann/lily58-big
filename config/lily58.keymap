/*
 * Copyright (c) 2020 The ZMK Contributors
 *
 * SPDX-License-Identifier: MIT
 */

#include <behaviors.dtsi>
#include <behaviors/num_word.dtsi>
#include <behaviors/unicode.dtsi>
#include <dt-bindings/zmk/bt.h>
#include <dt-bindings/zmk/keys.h>
#include "zmk-helpers/helper.h"
#include "lily58keys.h"
// define layers name with numbers
#define MACOS 0
#define WINDOWS 1
#define GAMING 2
#define LOWER 3
#define RAISE 4
#define DEV 5
#define MOUSE 6

#include "features/macros.dtsi"
#include "features/morph.dtsi"
#include "features/hrm.dtsi"
#include "features/combos.dtsi"
#include "features/mouse.dtsi"

// Tap: repeat after alpha, else sticky-shift |
// Shift + tap/ double-tap: caps-word | Hold: shift.
ZMK_HOLD_TAP(magic_shift, bindings = <&kp>, <&magic_shift_tap>;
             flavor = "balanced"; tapping-term-ms = <200>;
             quick-tap-ms = <QUICK_TAP_MS>;)
ZMK_MOD_MORPH(magic_shift_tap, bindings = <&shift_repeat>, <&caps_word>;
              mods = <(MOD_LSFT)>;)

ZMK_ADAPTIVE_KEY(
    shift_repeat, bindings = <&sk LSHFT>;
    repeat {
      trigger-keys = <A B C D E F G H I J K L M N O P Q R S T U V W X Y Z>;
      bindings = <&key_repeat>;
      max-prior-idle-ms = <1200>;
      strict-modifiers;
    };)
&caps_word { // Mods deactivate caps-word, requires PR #1451. [TODO: rebase]
  /delete-property/ ignore-modifiers;
};

// Smart-mouse, requires tri-state module.
ZMK_TRI_STATE(
    smart_mouse, bindings = <&tog MOUSE>, <&none>, <&tog MOUSE>;
    ignored-key-positions =
        <LT1 LT2 LH0 LH1 RT1 RT2 RT3 RM0 RM1 RM2 RM3 RM4 RB1 RB2 RB3 RH0 RH1>;
    ignored-layers = <MOUSE RAISE LOWER>;)


// Tap: copy | double-tap: cut.
ZMK_TAP_DANCE(copy_cut, bindings = <&kp LC(INS)>, <&kp LC(X)>;
              tapping-term-ms = <200>;)


&uc {
  default-mode = <UC_MODE_MACOS>;
};

/ {
    keymap {
        compatible = "zmk,keymap";

        MacOs {
            // ------------------------------------------------------------------------------------------------------------
            // | ESC |  1  |  2  |  3  |  4  |  5  |               |  6  |  7  |  8  |  9  |  0  | BSPC |
            // | TAB |  Q  |  W  |  E  |  R  |  T  |               |  Y  |  U  |  I  |  O  |  P  |  -   6
            // |CTRL |  A  |  S  |  D  |  F  |  G  |               |  H  |  J  |  K  |  L  |  ;  |  '   |
            // |SHIFT|  Z  |  X  |  C  |  V  |  B  | [     |  ]     |  N  |  M  |  ,  |  .  |  /  |SHIFT|
            //                   | ALT | GUI | LOWER | SPACE | RET | RAISE | BSPC | GUI |
            display-name = "Macos";
            bindings = <
&kp ESC           &kp N1  &kp N2  &kp N3    &kp N4    &kp N5                         &kp N6  &kp N7  &kp N8     &kp N9   &kp N0    &kp BACKSPACE
&lt 5 TAB         &kp Q   &kp W   &kp E     &kp R     &kp T                          &kp Y   &kp U   &kp I      &kp O    &kp P     &kp MINUS
&kp LEFT_CONTROL  &hml LCTRL A     &hml LALT S  &hml LGUI D  &hml LSHFT F   &kp G                          &kp H   &hmr RSHFT J  &hmr LGUI K  &hmr LALT L   &hmr LCTRL SEMI  &kp SQT
&kp LEFT_SHIFT    &kp Z   &kp X   &kp C     &kp V     &kp B   &kp LBKT     &kp RBKT  &kp N   &kp M   &kp COMMA  &kp DOT  &kp FSLH  &kp RSHFT
                                  &kp LALT  &kp LC(LS(LA(LGUI)))  &mo 3   &kp SPACE    &kp RET   &mo 4   &mo 5   &magic_shift LSHFT 0
            >;
        };

        Windows {
            // ------------------------------------------------------------------------------------------------------------
            // | ESC |  1  |  2  |  3  |  4  |  5  |               |  6  |  7  |  8  |  9  |  0  | BSPC |
            // | TAB |  Q  |  W  |  E  |  R  |  T  |               |  Y  |  U  |  I  |  O  |  P  |  -   |
            // |CTRL |  A  |  S  |  D  |  F  |  G  |               |  H  |  J  |  K  |  L  |  ;  |  '   |
            // |SHIFT|  Z  |  X  |  C  |  V  |  B  | [     |  ]     |  N  |  M  |  ,  |  .  |  /  |SHIFT|
            //                   | GUI | ALT | LOWER | SPACE | RET | RAISE | BSPC | GUI |

            display-name = "Windows";
            bindings = <
&kp ESC           &kp N1  &kp N2  &kp N3        &kp N4        &kp N5                         &kp N6  &kp N7  &kp N8         &kp N9   &kp N0    &kp BACKSPACE
&lt 5 TAB         &kp Q   &kp W   &kp E         &kp R         &kp T                          &kp Y   &kp U   &kp I          &kp O    &kp P     &kp MINUS
&kp LEFT_CONTROL  &hml LALT A     &hml LCTRL S  &hml LGUI D  &hml LSHFT F   &kp G                          &kp H   &hmr RSHFT J  &hmr LGUI K  &hmr LCTRL L   &hmr LALT SEMI  &kp SQT
&kp LEFT_SHIFT    &kp Z   &kp X   &kp C         &kp V         &kp B   &kp LBKT     &kp RBKT  &kp N   &kp M   &kp COMMA      &kp DOT  &kp FSLH  &kp RSHFT
                                  &kp LEFT_GUI  &kp LEFT_ALT  &mo 3   &kp SPACE    &kp RET   &mo 4   &mo 5   &magic_shift LSHFT 0
            >;
        };

        Gaming {
            display-name = "Gaming";
            bindings = <
&kp ESC           &kp N1  &kp N2  &kp N3        &kp N4        &kp N5                                   &kp N6  &kp N7  &kp N8     &kp N9   &kp N0    &kp BACKSPACE
&kp TAB           &kp Q   &kp W   &kp E         &kp R         &kp T                                    &kp Y   &kp U   &kp I      &kp O    &kp P     &kp MINUS
&kp LEFT_SHIFT    &kp A   &kp S   &kp D         &kp F         &kp G                                    &kp H   &kp J   &kp K      &kp L    &kp SEMI  &kp SQT
&kp LEFT_CONTROL  &kp Z   &kp X   &kp C         &kp V         &kp B             &kp LBKT     &kp RBKT  &kp N   &kp M   &kp COMMA  &kp DOT  &kp FSLH  &kp RSHFT
                                  &kp LEFT_GUI  &kp LEFT_ALT  &kp LEFT_CONTROL  &kp SPACE    &kp RET   &mo 4   &mo 5   &mo 3
            >;
        };

        lower_layer {
            // ------------------------------------------------------------------------------------------------------------
            // | BTCLR | BT1 | BT2 | BT3 | BT4 | BT5 |               |PREV|PLAY |NEXT | VOL-| VOL+| DEL |
            // |  F1   | F2  | F3  | F4  | F5  | F6  |               | F7 | F8  | F9  | F10 | F11 |  =  |
            // |  `    |  !  |  @  |  #  |  $  |  %  |               |  ^ |  &  |  *  | (   | )   |  ~  |
            // |       |     |     |     |     |     |        |       |     |  _  |  +  | {   | }   |  |  |
            //                    |      |      |      |        |SPC |      |      |      |            display-name = "Lower";

            display-name = "Lower";
            bindings = <
&bt BT_CLR  &bt BT_SEL 0  &bt BT_SEL 1  &bt BT_SEL 2  &bt BT_SEL 3  &bt BT_SEL 4                           &kp C_PREVIOUS  &kp C_PLAY      &kp C_NEXT       &kp C_VOLUME_DOWN  &kp C_VOL_UP  &kp DEL
&kp F1      &kp F2        &kp F3        &kp F4        &kp F5        &kp F6                                 &kp F7          &kp F8          &kp F9           &kp F10            &kp F11       &kp EQUAL
&kp GRAVE   &kp EXCL      &kp AT        &kp HASH      &kp DOLLAR    &kp PRCNT                              &kp CARET       &kp AMPS        &kp KP_MULTIPLY  &kp LPAR           &kp RPAR      &kp TILDE
&trans      &trans        &trans        &trans        &trans        &trans        &trans    &trans         &trans          &kp UNDERSCORE  &kp KP_PLUS      &kp LBRC           &kp RBRC      &kp PIPE
                                        &trans        &trans        &trans        &trans    &kp LG(SPACE)  &trans          &trans          &trans
            >;
        };

        raise_layer {
            // ------------------------------------------------------------------------------------------------------------
            // |     |     |     |     |     |     |               |     |     |     |     |     |      |
            // |  `  |  1  |  2  |  3  |  4  |  5  |               |  6  |  7  |  8  |  9  |  0  |      |
            // | F1  | F2  | F3  | F4  | F5  | F6  |               | <-  |  ↓  |  ↑  |  -> |     |      |
            // | F7  | F8  | F9  |F10  |F11  |F12  |        |       |  +  |  -  |  =  | [   | ]   |  \  |
            //                    |     |     |      |      |      |      |      |      |

            display-name = "Raise";
            bindings = <
&arrow     &equalsarrow  &trans  &trans   &trans   &trans                     &trans       &trans          &trans        &trans           &trans    &trans
&kp GRAVE  &kp N1         &kp N2  &kp N3   &kp N4   &kp N5                     &kp N6       &kp N7          &kp N8        &kp N9           &kp N0    &trans
&kp F1     &kp F2         &kp F3  &kp F4   &kp F5   &kp F6                     &kp LEFT     &kp DOWN_ARROW  &kp UP_ARROW  &kp RIGHT_ARROW  &trans    &trans
&kp F7     &kp F8        &kp F9  &kp F10  &kp F11  &kp F12  &trans    &trans  &kp KP_PLUS  &kp MINUS       &kp EQUAL     &kp LBKT         &kp RBKT  &kp BSLH
                                 &trans   &trans   &trans   &trans    &trans  &trans       &trans          &trans
            >;
        };

        Dev {
            // ------------------------------------------------------------------------------------------------------------
            // |  ->  |  =>  |     |     |     |     |               |     |     |     |     |     |     |
            // |      |      | ↑   |      |     |     |               |     |     |     |     |     |     |
            // |      | ←    | ↓   | →    |     |     |               |     |     |     |     |     |     |
            // |      |      |     |      |     |     |        |       |     |     |     |     |     |     |
            //                    |      |      |      |      |      |      |      |      |

            display-name = "Dev";
            bindings = <
&arrow  &equalsarrow    &trans          &trans           &trans  &trans                       &trans    &trans        &trans        &trans     &trans  &trans
&trans  &trans          &mmv MOVE_UP    &trans           &trans  &trans                       &arrow    &equalsarrow  &trans        &trans     &trans  &trans
&trans  &mmv MOVE_LEFT  &mmv MOVE_DOWN  &mmv MOVE_RIGHT  &trans  &trans                       &kp LEFT  &kp DOWN      &kp UP_ARROW  &kp RIGHT  &trans  &trans
&trans  &trans          &trans          &trans           &trans  &trans  &trans       &trans  &trans    &trans        &trans        &trans     &trans  &trans
                                        &trans           &trans  &trans  &mkp LCLK    &trans  &trans    &trans        &trans
            >;
        };

        Mouse {
            display-name = "Mouse";
            bindings = <
&trans  &trans  &trans  &trans  &trans  &trans                       &trans  &trans    &trans  &trans    &trans  &trans
&trans  &trans  &trans  &trans  &trans  &trans                       &trans  &kp PG_UP U_MS_U  &kp PG_DN &trans  &trans
&trans  &trans  &trans  &trans  &trans  &trans                       U_WH_L  U_MS_L    U_MS_D  U_MS_R    U_WH_R  &trans
&trans  &trans  &trans  &trans  &trans  &trans  &trans       &trans  &trans  &mkp LCLK &mkp MCLK &mkp RCLK &trans  &trans
                        &trans  &trans  &trans  &trans       U_WH_U  U_WH_D  &trans    &trans
            >;
        };
  };
};
